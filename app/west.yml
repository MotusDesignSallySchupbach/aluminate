## app/west.yml
```yaml
# Copyright (c) 2023 Motus Performance

manifest:
  remotes:
    - name: zephyr-app
      url-base: https://github.com/motus-engineering/zephyr-app
    - name: ncs
      url-base: https://github.com/nrfconnect

  projects:
    - name: nrf
      remote: ncs
      repo-path: sdk-nrf
      revision: main
      import: true

  self:
    west-commands: scripts/west-commands.yml
```
